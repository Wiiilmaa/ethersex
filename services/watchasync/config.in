## services/watchasync/config.in
```kconfig
dep_bool_menu "watchasync service (EXPERIMENTAL)" WATCHASYNC_SUPPORT $TCP_SUPPORT $DNS_SUPPORT $CONFIG_EXPERIMENTAL
  string "Service" CONF_WATCHASYNC_SERVICE "volkszaehler.org"
  string "Path" CONF_WATCHASYNC_PATH "/httplog/httplog.php"
  bool "Include Prefix" CONF_WATCHASYNC_INCLUDE_PREFIX
    string "Prefix" CONF_WATCHASYNC_PREFIX "PC"
  dep_bool "Include unix timstamp" CONF_WATCHASYNC_INCLUDE_TIMESTAMP $CLOCK_DATETIME_SUPPORT
  bool "Include uuid" CONF_WATCHASYNC_INCLUDE_UUID
    string "UUID" CONF_WATCHASYNC_UUID "12345678-9ABC-DEF0-1234-56789ABCDEF0" $CONF_HTTPLOG_INCLUDE_UUID
      script_set "  Randomize UUID" RANDOM_UUIDC "scripts/random_uuid CONF_WATCHASYNC_UUID"
  int "Number of pins to watch" CONF_WATCHASYNC_PINS 8
  int "Resolution in seconds" CONF_WATCHASYNC_RESOLUTION 1
  int "Buffersize" CONF_WATCHASYNC_BUFFERSIZE 64
  dep_bool "High Volume" CONF_WATCHASYNC_HIGHVOLUME $CLOCK_DATETIME_SUPPORT
    choice "Counterrange"					\
		"8Bits			WATCHASYNC_8BITS	\
		16Bits			WATCHASYNC_16BITS	\
		32Bits			WATCHASYNC_32BITS"	\
		8Bits		CONF_WATCHASYNC_COUNTERRANGE
  comment  "Debugging Flags"
    dep_bool 'WATCHASYNC' DEBUG_WATCHASYNC $DEBUG $WATCHASYNC_SUPPORT
endmenu
```
